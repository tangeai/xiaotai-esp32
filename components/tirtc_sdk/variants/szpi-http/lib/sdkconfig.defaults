## lckfb-szpi-esp32s3-tirtc/main/Kconfig.projbuild
```kconfig
menu "XiaoTai application"
config XIAOTAI_DISCOVERY_URL
    string "ThingConnect service discovery URL"
    default "http://ep-open.tangeopen.com/services"
    help
        Existing development endpoint is retained. Override for your deployment.
        HTTPS requires valid time, trusted certificates and sufficient TLS memory.
config XIAOTAI_DEVELOPMENT_CONSOLE
    bool "Enable local development command console"
    default n
    help
        Development only: enables serial commands that can alter credentials
        and inject session actions. Product builds keep logs and BOOT wake,
        but do not create this command task.
config XIAOTAI_PORTAL_URL
    string "Device binding portal URL (display only)"
    default "https://demo-open.tange-ai.com"
config XIAOTAI_WAKE_THRESHOLD_MILLI
    int "Voicute wake threshold (thousandths)"
    range 50 990
    default 700
    help
        Model-specific; requires acoustic validation. Console overrides are volatile.
config XIAOTAI_CAPTURE_AGC
    bool "Adaptive uplink gain after AEC"
    default y
    help
        ESP-SR WebRTC digital AGC with limiter. Does not modify the AEC
        reference or codec gain. Adds a fixed 10 ms streaming delay.
config XIAOTAI_WAKE_CAPTURE_AGC
    bool "Use post-AEC adaptive gain for wake input"
    depends on XIAOTAI_CAPTURE_AGC
    default y
    help
        Share the existing 16 kHz AGC output before uplink downsampling.
        No second AGC, added task or audio buffer. Preserve the model and
        threshold and account for the 10 ms AGC delay in wake timestamps.
config XIAOTAI_CAPTURE_AGC_GAIN_DB
    int "Uplink AGC compression gain (dB)"
    range 0 18 if IDF_TARGET_ESP32S3
    range 0 12
    default 15 if IDF_TARGET_ESP32S3
    default 9
    help
        WebRTC compression gain, not a fixed volume multiplier. The target is
        -6 dBFS. The S3 default adds 6 dB of gain allowance compared with 9 dB;
        the limiter still protects loud input. More gain also amplifies residual
        echo and noise. The P4 default is unchanged.
endmenu
```

## main/Kconfig.projbuild
```kconfig
menu "XiaoTai"
config XIAOTAI_APP
    bool
    default y

choice BOARD_TYPE
    prompt "XiaoTai board"
    config BOARD_TYPE_LICHUANG_DEV_S3
        bool "LCKFB SZPI ESP32-S3 V1.0.1"
        depends on IDF_TARGET_ESP32S3
    config BOARD_TYPE_M5STACK_CORE_S3
        bool "M5Stack CoreS3-Lite"
        depends on IDF_TARGET_ESP32S3
    config BOARD_TYPE_XMINI_C3_V3
        bool "Xmini C3 V3"
        depends on IDF_TARGET_ESP32C3
    config BOARD_TYPE_WAVESHARE_ESP32_P4_WIFI6_TOUCH_LCD_3_5
        bool "Waveshare P4 3.5 rev3.2"
        depends on IDF_TARGET_ESP32P4
    config BOARD_TYPE_WT99P461_S1
        bool "WT99P461-S1 1V1"
        depends on IDF_TARGET_ESP32P4
    config BOARD_TYPE_MZ28_AI_PPD
        bool "MZ28-AI-PPD V1.2"
        depends on IDF_TARGET_ESP32C3
endchoice

config XIAOTAI_AI
    bool "TiRTC AI"
    depends on !BOARD_TYPE_MZ28_AI_PPD
config XIAOTAI_DEVICE_CALL
    bool "Device calls"
    depends on !BOARD_TYPE_MZ28_AI_PPD
config XIAOTAI_WECHAT_VOIP
    bool "WeChat VoIP"
config XIAOTAI_ROOM
    bool "LIVE/GROUP rooms"
    depends on !BOARD_TYPE_MZ28_AI_PPD
config XIAOTAI_H5_STREAM
    bool "Web real-time audio session"
    depends on !BOARD_TYPE_MZ28_AI_PPD
config XIAOTAI_H5_VIDEO
    bool "Web camera video"
    depends on XIAOTAI_H5_STREAM
    depends on IDF_TARGET_ESP32S3 || IDF_TARGET_ESP32P4
config XIAOTAI_AI_VISION
    bool "AI vision"
    depends on XIAOTAI_AI
    depends on IDF_TARGET_ESP32S3 || IDF_TARGET_ESP32P4
endmenu
```

## main/boards/xmini/c3-v3/drivers/xmini_board/Kconfig.projbuild
```kconfig
config XMINI_USB_TIMING_PROBE
    bool "Enable one-shot USB tick catch-up diagnostic probe"
    depends on IDF_TARGET_ESP32C3 && ESP_CONSOLE_USB_SERIAL_JTAG_ENABLED
    default n
    help
        Diagnostic builds only. Retains the original once-per-boot 8 ms IRQ
        timing probe; never enable in a product profile.
```

## main/xiaotai/application/p4/startup/Kconfig.xiaotai
```kconfig
menu "XiaoTai application"
config XIAOTAI_DISCOVERY_URL
    string "ThingConnect service discovery URL"
    default "https://ep-open.tangeopen.com/services"
    help
        The response must use HTTPS for HTTP services, MQTTS for MQTT and include
        tirtc-srv. TiRTC consumes the discovered endpoint instead of a second
        compile-time address. Override only with an equivalent TLS deployment.
config XIAOTAI_DEVELOPMENT_CONSOLE
    bool "Enable local development command console"
    default n
    help
        Development only: enables serial commands that can alter credentials
        and inject session actions. Product builds keep logs and BOOT wake,
        but do not create this command task.
config XIAOTAI_PORTAL_URL
    string "Device binding portal URL (display only)"
    default "https://xiaotai.chat/"
config XIAOTAI_FALLBACK_DNS_IPV4
    string "Fallback IPv4 DNS server (empty disables)"
    default "223.5.5.5"
    help
        Fill only an empty fallback DNS slot after STA obtains an IP address.
        Keep DHCP main/backup DNS unchanged. The resolver can use this server
        when DHCP supplies no DNS, or after its preferred servers fail.
        Private networks can specify their resolver or disable this policy.
config XIAOTAI_CAPTURE_AGC
    bool "Adaptive uplink gain after AEC"
    default y
    help
        ESP-SR WebRTC digital AGC with limiter. Does not modify the AEC
        reference or codec gain. Adds a fixed 10 ms streaming delay.
config XIAOTAI_WAKE_CAPTURE_AGC
    bool "Use post-AEC adaptive gain for wake input"
    depends on XIAOTAI_CAPTURE_AGC
    default y
    help
        Share the existing 16 kHz AGC output before uplink downsampling.
        No second AGC, added task or audio buffer. Preserve the model and
        threshold and account for the 10 ms AGC delay in wake timestamps.
config XIAOTAI_CAPTURE_AGC_GAIN_DB
    int "Uplink AGC compression gain (dB)"
    range 0 18 if IDF_TARGET_ESP32S3
    range 0 12
    default 15 if IDF_TARGET_ESP32S3
    default 9
    help
        WebRTC compression gain, not a fixed volume multiplier. The target is
        -6 dBFS. The S3 default adds 6 dB of gain allowance compared with 9 dB;
        the limiter still protects loud input. More gain also amplifies residual
        echo and noise. The P4 default is unchanged.
endmenu
```
