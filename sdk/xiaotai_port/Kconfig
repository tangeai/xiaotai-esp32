## sdk/xiaotai_port/Kconfig
```kconfig
# SPDX-License-Identifier: MIT
# Build options of the port layer. Each symbol maps to the macro of the same
# name without CONFIG_ in include/xiaotai/port_config.h, which also holds the
# value used where Kconfig does not exist (the host). Keep both in step.
# The defaults equal what the port used before the options existed, so a
# product that sets nothing builds as before.
menu "XiaoTai port layer"

    config XIAOTAI_PORT_MQTT_NATIVE_OVERLAY
        bool "Use the optional XiaoTai esp-mqtt source overlay"
        default n
        help
            The new product graph normally uses the locked stock esp-mqtt
            component. Enable only for validated products that need the native
            owner bridge, strict outbox admission, or native cleanup changes.

    config XIAOTAI_PORT_MQTT_PAYLOAD_ON_DEMAND
        bool "Allocate stock MQTT event payloads on arrival"
        depends on !XIAOTAI_PORT_MQTT_NATIVE_OVERLAY
        default n
        help
            Keep the same stock MQTT mailbox and worker, but allocate each
            accepted DATA fragment instead of keeping a full callback-copy
            arena. Allocation failure is reported as an ordered event gap.

    config XIAOTAI_PORT_HTTP_DEADLINE_TRANSPORT
        bool "Enable the V3 HTTP deadline transport"
        default n
        select ESP_HTTP_CLIENT_ENABLE_CUSTOM_TRANSPORT
        help
            Selected by the V3 port component's defaults. The HTTP parser
            must use the port's deadline-aware transport, rather than a stock
            blocking transport that can evade a whole-request limit.

    config XIAOTAI_PORT_HTTP_DNS_ON_DEMAND
        bool "Allocate HTTP DNS jobs on demand"
        default n
        help
            The product selector enables this for boards without external RAM.
            Keep the same four-job bound. A timed-out job still occupies a
            slot until the lwIP worker or completion callback retires it.

    config XIAOTAI_PORT_USB_MONITOR_FIX
        bool "USB Serial/JTAG monitor elapsed-time correction"
        depends on ESP_CONSOLE_USB_SERIAL_JTAG
        default y
        help
            Applies to reviewed ESP-IDF source identities in a V3 product build.
            Products that did not use the correction keep it disabled.

    config XIAOTAI_PORT_USB_TIMING_PROBE
        bool "Allow the one-shot USB tick timing probe"
        depends on XIAOTAI_PORT_USB_MONITOR_FIX
        default n
        help
            Development only. Production builds must leave this disabled.

    config XIAOTAI_PORT_HEAP_TRACE_RECORDS
        int "Standalone heap trace records"
        depends on HEAP_TRACING_STANDALONE && !HEAP_TRACE_HASH_MAP
        range 1 4096
        default 640
        help
            Diagnostic-only entries allocated in internal memory on trace start.

    config XIAOTAI_LOG_LEVEL_CEILING
        int "Highest level of XiaoTai log lines compiled in"
        range 0 4
        default 4
        help
            0 off, 1 error, 2 warning, 3 info, 4 debug. Lines above the
            ceiling are not in the image. 4 keeps debug lines available to
            AT+LOGLEVEL at run time; 3 saves their text in flash.

    config XIAOTAI_KV_SLOTS
        int "Storage worker job slots"
        range 2 8
        default 4
        help
            Each slot keeps about 570 bytes of bulk memory (internal RAM on
            boards without external RAM). Lower it only after the storage
            statistics showed full=0 under the product's heaviest use.

    config XIAOTAI_KV_WORKER_STACK_BYTES
        int "Storage worker stack (bytes, internal RAM)"
        range 2560 8192
        default 4096
        help
            The worker runs every flash read and write. Lower it only from the
            worker's measured lowest free stack (the task list diagnostics),
            keeping a margin of at least 512 bytes.

endmenu
```

## sdk/xiaotai_transport/Kconfig
```kconfig
# SPDX-License-Identifier: MIT
# Options of the XiaoTai transport engine. Each maps to the macro of the same
# name without the CONFIG_ prefix in include/xiaotai/transport_config.h; the
# defaults here and there are the same.
menu "XiaoTai transport engine"

    config XIAOTAI_TIRTC_IDLE_STACK_COMPACT
        bool "Use the audited Mini RTC startup queue profile"
        default n
        help
            Keep both vendor 8192-byte listener stacks and reduce the startup
            queue stack to 2048 bytes during TiRtcStart. This is a fixed profile
            for the locked no-external-RAM Mini port, not a general stack-size override.
            The build rejects an incompatible target or SDK. Independent
            session stacks are configured separately.

    config XIAOTAI_TIRTC_SESSION_STACK_9216
        bool "Reserve 9216 bytes for independent TiRTC session tasks"
        depends on !SPIRAM && FREERTOS_CHECK_STACKOVERFLOW_CANARY && APP_BUILD_USE_FLASH_SECTIONS
        default n
        help
            For the audited Mini SDK and toolchain, reserve an extra 1024
            bytes for newly created session tasks. Shared listeners, other
            tasks and other SDKs are unaffected. The product generator enables
            it by default for boards with no external RAM.

    config XIAOTAI_TRANSPORT_MEMTRACE
        bool "Trace the RTC stack's own allocations (diagnostic builds)"
        default n
        help
            Wraps the RTC package's allocator (Mx_malloc, Mx_calloc,
            Mx_realloc, Mx_free) at link time, records which blocks the stack
            holds and its failed allocations, and registers AT+MEMTRACE. The
            linked package must call these functions, otherwise the link
            fails. Diagnostic builds only: every allocation of the stack then
            takes a short critical section.

    config XIAOTAI_TRANSPORT_LISTENERS
        int "Inbound link listeners"
        range 1 16
        default 4
        help
            Listeners the modules of this build may register
            (xiaotai_link_listen). The table, about 100 bytes per entry, is
            one block of BULK memory taken at the first registration (none in
            a provisioning boot). Raise it when the selected modules register
            more than four.

endmenu
```

## sdk/xiaotai_ui/Kconfig
```kconfig
# SPDX-License-Identifier: MIT
# Options of the XiaoTai UI system. Each maps to the macro of the same name
# without the CONFIG_ prefix in include/xiaotai/ui_config.h; the defaults here
# and there are the same (the header holds the value without external RAM
# where the default depends on it).
menu "XiaoTai UI system"

    config XIAOTAI_UI_TASK
        bool "UI task for displays drawn whole-frame"
        default y if SPIRAM
        default n
        help
            With it, every display has its own UI task. Without it, a display
            drawn by the whole-frame backend (small one-bit screens) is served
            by timers on the framework owner task: no task stack, but each
            frame transfer delays the owner task. Displays drawn with LVGL
            always have their task, and so does a theme that needs more stack
            than an owner-task handler may use.

    config XIAOTAI_UI_OWNER_FRAME_WORKSPACE
        bool "Borrow a reserved owner workspace for frame drawing"
        depends on !XIAOTAI_UI_TASK && !XIAOTAI_UI_LVGL && !SPIRAM
        default n
        help
            For single-display owner-timer FRAME builds only. A producer
            may offer its typed view-build workspace during initialization;
            the theme borrows it only for a later synchronous render.
            Last-sent pixels and capture output are always independent.

    config XIAOTAI_UI_TASK_PRIORITY
        int "Priority of the UI task"
        range 1 24
        default 6
        help
            Each display has one UI task that draws and reads the pointer.
            Keep it below the audio capture and playout tasks.

    config XIAOTAI_UI_TASK_CORE
        int "Core of the UI task (-1: any)"
        range -1 1
        default -1
        help
            Products with two cores keep the UI task off the core their audio
            processing runs on.

    config XIAOTAI_UI_TASK_STACK_BYTES
        int "Least stack of the UI task in bytes"
        range 2048 65536
        default 4096
        help
            The task gets the larger of this and what its theme asks for. The
            stack lives in external RAM where the board has it.

    config XIAOTAI_UI_POINTER_READ_MS
        int "Pointer read period in ms"
        range 5 100
        default 15
        help
            How often the touch controller is read while nothing touches it,
            also while the screen sleeps.

    config XIAOTAI_UI_POINTER_CONTACT_MS
        int "Pointer read period in ms during a contact"
        range 4 100
        default 10
        help
            The same while a finger is on the display and shortly after. A
            display with touch has a small task for it, so frames neither
            delay nor hide a touch. Below the controller's own report period
            it only reads the same report again.

    config XIAOTAI_UI_PRESENT_TASK
        bool "Send strips from a task of their own"
        default n
        help
            A display drawn in strips gets a second strip buffer and a small
            task that hands each strip to the panel, so the next strip is
            drawn while the last one is sent. Worth it where sending a strip
            takes about as long as drawing it (a large panel on a serial
            bus). Costs a second strip buffer and the task's stack in
            internal RAM.

    config XIAOTAI_UI_LVGL
        bool "LVGL backend"
        default n
        help
            Needed by the colour themes. Without it only the whole-frame
            backend is built (small one-bit displays).
            Products using LVGL select LV_USE_CUSTOM_MALLOC to put LVGL
            allocations in the same BULK memory class as UI frame buffers.

    config XIAOTAI_UI_RGB_SCANOUT
        bool
        default n
        help
            Frame-buffer scanout on ESP-IDF's RGB (parallel) LCD engine, for
            displays whose part reports XIAOTAI_SCANOUT_RGB. Selected by such
            a panel part; without it the LVGL backend keeps no RGB event
            slots, so boards without an RGB panel carry nothing for it.

    config XIAOTAI_UI_CAPTURE
        bool "Screen capture"
        default y
        help
            Builds xiaotai_ui_capture() and the command AT+SCREEN. On the LVGL
            backend a capture takes one more frame of memory while it runs.

    config XIAOTAI_UI_THEMES_MAX
        int "Themes the registry holds"
        range 1 64
        default 8
        help
            Registering more is an error at init, so the start fails instead
            of losing a theme. The same holds for the three below.

    config XIAOTAI_UI_TEMPLATES_MAX
        int "Custom templates the registry holds"
        range 1 128
        default 16

    config XIAOTAI_UI_IMAGES_MAX
        int "Images the registry holds"
        range 1 128
        default 16

    config XIAOTAI_UI_PAINTERS_MAX
        int "Direct painters per display (LVGL backend)"
        range 1 16
        default 4

endmenu
```

## sdk/xiaotai_video/Kconfig
```kconfig
# SPDX-License-Identifier: MIT
# Options of the XiaoTai video engine. Each one is mapped to a macro of the
# same name without the CONFIG_ prefix in include/xiaotai/video_config.h, whose
# defaults equal the defaults here.
menu "XiaoTai video engine"

    config XIAOTAI_VIDEO_UPLINK_CLOCK_OVERLAY
        bool "Draw the time of day on uplink pictures"
        default n
        help
            Draws HH:MM:SS.mmm into the top-left corner of every uplink
            picture that passes through a transform, before it is encoded.
            A bench aid for measuring end-to-end delay; the peer sees it.

    config XIAOTAI_VIDEO_SOFTWARE_UPLINK_CORE
        int "Core of the camera task with a software encoder (-1: any)"
        range -1 1
        default 0
        help
            A software encoder competes with echo cancellation for the cache
            of external RAM. Keep it on the core that does not run audio
            processing.

    config XIAOTAI_VIDEO_HARDWARE_TASK_PRIORITY
        int "Priority of the hardware codec tasks"
        range 3 20
        default 7
        help
            Priority of the camera task with a hardware encoder and of the
            hardware JPEG decode task. Keep it strictly below every audio
            task of the media engine: 7 when audio runs at 8 or above, 5
            when audio capture runs at 7.

    config XIAOTAI_VIDEO_ACCELERATORS
        bool "Use the chip's picture accelerators"
        default n if XIAOTAI_UI_RGB_SCANOUT
        default y
        help
            The pixel accelerator and the hardware JPEG decoder. Both move
            pictures with the two-dimensional DMA. On a display the chip
            scans out of external memory by itself (an RGB panel) that work
            makes the panel lose pixels and the picture roll until the next
            start, so it is off there and software does the same.

    config XIAOTAI_VIDEO_JPEG_SOFTWARE_DECODER
        bool "Decode JPEG pictures in software"
        default y if XIAOTAI_UI_RGB_SCANOUT
        default n
        help
            For a product that shows JPEG pictures of another device on a
            chip without a JPEG decoder, or with one it does not use (above).

    config XIAOTAI_VIDEO_JPEG_ENCODER
        bool "Encode JPEG pictures in software"
        default y
        help
            A product that sends no pictures can leave it out.

    config XIAOTAI_VIDEO_PROFILES_MAX
        int "Uplink profiles the requirement table holds"
        range 1 32
        default 8
        help
            Each table is allocated from bulk memory by its first
            registration. Registering more is an error at init, so the start
            fails instead of losing a profile. The same holds for the two
            below.

    config XIAOTAI_VIDEO_VIEWPORTS_MAX
        int "Viewports the requirement table holds (one per display)"
        range 1 16
        default 4

    config XIAOTAI_VIDEO_BACKENDS_MAX
        int "Backends of one kind (encoders, decoders, transforms)"
        range 2 32
        default 8

endmenu
```
