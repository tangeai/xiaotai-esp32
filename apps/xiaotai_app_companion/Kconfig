## apps/xiaotai_app_companion/Kconfig
```kconfig
# SPDX-License-Identifier: MIT
config XIAOTAI_COMPANION_WECHAT_CODE
    bool "Include the companion WeChat contact QR image"
    depends on XIAOTAI_UI_LVGL
    default n
    help
        Include the shipped QR image when the product selects xiaotai_ui
        and offers adding WeChat contacts by scanning the display.
```

## apps/xiaotai_app_door/Kconfig
```kconfig
menu "XiaoTai door application"

    config XIAOTAI_DOOR_TEMPLATES
        bool "The door's own pages for large colour displays"
        depends on XIAOTAI_UI_LVGL
        default y
        help
            Carries the door's own page templates, pictures, icons and fonts
            (about 1 MB of flash) for displays of 440 x 300 and more. Smaller
            displays show the door with the theme's ordinary pages; the build
            turns this off for a board whose first display is that small
            (scripts/sdk_selection.py). A product may set it either way in its
            "options".

endmenu
```

## sdk/modules/xiaotai_mod_ai_talk/Kconfig
```kconfig
# SPDX-License-Identifier: MIT
# Options of the XiaoTai AI talk module. Each maps to the macro of the same
# name without the CONFIG_ prefix in include/xiaotai/modules/ai_talk_config.h;
# the defaults here and there are the same.
menu "XiaoTai AI talk module"

    config XIAOTAI_AI_TALK_ROLE_REQUIRED
        bool "Refuse a session token without a role"
        default n
        help
            A token reply whose data.role_id is missing or empty ends the
            conversation as refused. Off: the role is optional.

    config XIAOTAI_AI_TALK_START_NEEDS_PROFILE
        bool "Start a conversation only after the device profile was accepted"
        default n
        help
            Until the platform reports the device profile accepted in the
            current session, a start is refused as if the platform were
            offline.

    config XIAOTAI_AI_TALK_NOTIFY_FAILURES
        bool "Tell the service when a conversation fails on the device"
        default n
        help
            A conversation that ends because of a deadline, a refused or
            unsupported session, the audio session, a dropped command or a
            failed send sends end_session first while its link is open. Off:
            only a local stop and a revocation send it.

    config XIAOTAI_AI_TALK_DROPPED_ENDS
        bool "End the conversation on a command the transport could not keep"
        default n
        help
            A command delivered as dropped (too large, or no room in the
            command pool) ends the conversation. Off: it is ignored.

    config XIAOTAI_AI_TALK_TOOLS_MAX
        int "Tools the conversation's registry holds"
        range 1 64
        default 32
        help
            Names applications and modules may register for the service's
            device actions. Each entry is 20 bytes of static memory; a
            product without external RAM sets what its applications use.

endmenu
```

## sdk/modules/xiaotai_mod_binding/Kconfig
```kconfig
# SPDX-License-Identifier: MIT
# Options of the XiaoTai binding module. Each maps to the macro of the same
# name without the CONFIG_ prefix in include/xiaotai/modules/binding_config.h;
# the defaults here and there are the same.
menu "XiaoTai binding module"

    config XIAOTAI_BINDING_DEV_COMMANDS
        bool "Register AT+BIND SET and AT+BIND CLEAR"
        default n
        help
            Adds two verbs to AT+BIND that write (key in hexadecimal) and
            erase the stored device identity directly, without the server,
            then restart. Development and bench firmware only: anyone with
            the console could replace the device's identity. The device key
            is never echoed.

    config XIAOTAI_BINDING_GUARDS_MAX
        int "Binding guards the registry holds"
        range 1 16
        default 4
        help
            Other modules' vetoes against starting a binding attempt.
            Registering more is an error at init, so the start fails instead
            of losing a veto. The same holds for the option below.

    config XIAOTAI_BINDING_PREPARES_MAX
        int "Binding preparation steps the registry holds"
        range 1 8
        default 2
        help
            Other modules' storage steps that must succeed before a binding
            report is sent. Each may take up to 10 seconds of an attempt.

endmenu
```

## sdk/modules/xiaotai_mod_provisioning/Kconfig
```kconfig
# SPDX-License-Identifier: MIT
# Options of the XiaoTai provisioning module. Each maps to the macro of the
# same name without the CONFIG_ prefix in
# include/xiaotai/modules/provisioning_config.h; the defaults here and there
# are the same.
menu "XiaoTai provisioning module"

    config XIAOTAI_PROVISIONING_LOCAL_POLICY
        int "Local policy (0 orderly, 1 direct network change, 2 direct restart)"
        range 0 2
        default 0
        help
            0: quiesce, drain and settle before a request. Keep this for
            idle-only products. 1: change network without ending the active
            session first; needs concurrent network provisioning. 2: commit
            the Wi-Fi data and restart without ending the active session
            first; needs exclusive network provisioning. These policies are
            for native local actions; console commands keep policy 0.

    config XIAOTAI_PROVISIONING_SETTLE_WAIT_MS
        int "Longest wait for settings and the platform gate (ms, 0: no bound)"
        range 0 60000
        default 5000
        help
            Before handing a request to start over to the network engine the
            module waits until accepted setting changes have reached storage
            and, where a restart follows, until the platform gate is drained.
            After stored credentials it holds the restart until the settings
            are written. With the packed write barrier enabled, a timeout
            after stored credentials is reported without releasing the hold.
            0 waits without a deadline.

    config XIAOTAI_PROVISIONING_BEGIN_FAILURE
        int "Begin with a restart after it: on a setting not written (0 release, 1 hold, 2 continue)"
        range 0 2
        default 0
        help
            0: stop, open the platform gate, end the quiesce and report the
            failure. 1: stop and keep the quiesce and the gate until the
            begin is cancelled. 2: count the failure and continue as where
            provisioning is concurrent.

    config XIAOTAI_PROVISIONING_STORE_SETTINGS_HOLD
        bool "Keep the restart held when a setting is not written after stored credentials"
        default n
        help
            The failure is reported and an explicit retry waits for the
            settings again. Off: the restart goes ahead.

    config XIAOTAI_PROVISIONING_STORE_PACKED_RETRY
        bool "Require the packed settings commit before restarting after Wi-Fi setup"
        default n
        help
            On exclusive provisioning boot, hold on a failed packed settings
            write. Explicit retry submits only the already accepted image.

    config XIAOTAI_PROVISIONING_STORE_RETRY_MS
        int "Store failed credentials again every (ms, 0: only on request)"
        range 0 600000
        default 0
        help
            Credentials that were accepted but could not be stored are stored
            again on this period until they are stored or provisioning
            changes phase.

endmenu
```

## sdk/parts/xiaotai_part_audio/Kconfig
```kconfig
menu "XiaoTai PCM audio part"

    config XIAOTAI_AUDIO_RETAIN_I2S_DMA
        bool "Keep I2S channels and DMA reserved after boot"
        default n
        help
            Reserve I2S DMA at boot. Idle closes the codecs and stops audio
            clocks without releasing DMA. The product selector enables this
            for boards without external RAM unless the product overrides it.

endmenu
```

## sdk/parts/xiaotai_part_camera_dvp/Kconfig
```kconfig
# SPDX-License-Identifier: MIT
config XIAOTAI_PART_CAMERA_DVP_NATIVE
    bool "Apply the reviewed DVP camera driver overlay"
    default n
    help
        The default uses the original esp32-camera public API. Select this only
        with the reviewed driver to use native nonblocking dequeue, producer
        drop counters and checked SCCB cleanup. Legacy products are unaffected.

config XIAOTAI_PART_CAMERA_DVP_BENCH_DIAG
    bool "Sample DVP inputs after missing the first frame (bench only)"
    depends on IDF_TARGET_ESP32S3 && !XIAOTAI_PART_CAMERA_DVP_NATIVE
    default n
    help
        Read GPIO and LCD_CAM state if the stock driver produces no first
        frame in 500 ms. Results count sampled transitions, not wire edges.
        No pin setup, interrupt, sensor transaction, retry, or timeout change.

config XIAOTAI_PART_CAMERA_DVP_BENCH_POWER_DWELL
    bool "Compare DVP with 100 ms PWDN hold and 50 ms settle (bench only)"
    depends on IDF_TARGET_ESP32S3 && !XIAOTAI_PART_CAMERA_DVP_NATIVE && !XIAOTAI_PART_CAMERA_DVP_BENCH_DIAG
    default n
    help
        On a camera with a power-control line, hold PWDN for at least 100 ms
        after a successful assertion and settle for 50 ms after release.
        This does not imply that power to the sensor was removed. No retry.
```

## sdk/parts/xiaotai_part_panel_rgb/Kconfig
```kconfig
menu "XiaoTai RGB panel part"

    config XIAOTAI_PART_PANEL_RGB
        bool
        default y
        select XIAOTAI_UI_RGB_SCANOUT
        help
            Present whenever a board builds this part: the UI then keeps the
            event slots it needs to scan out from an RGB panel's buffers.

endmenu
```

## sdk/parts/xiaotai_part_panel_spi/Kconfig
```kconfig
# SPDX-License-Identifier: MIT
config XIAOTAI_PART_PANEL_SPI_DMA_OWNERSHIP_FIX
    bool "Use the reviewed SPI LCD DMA ownership correction"
    depends on SOC_PSRAM_DMA_CAPABLE && SPIRAM
    default n
    help
        The default uses stock esp_lcd, including its public PSRAM DMA option.
        Enable only to use the reviewed build-local factory for external DMA.
```

## sdk/themes/xiaotai_theme_lcd_kit/Kconfig
```kconfig
menu "XiaoTai colour theme kit"

    config XIAOTAI_THEME_LCD_LARGE_TEXT
        bool "26 px text on large displays"
        default n
        help
            Carries the 26 px text face, the 28 px icons and the larger digits
            (about 0.7 MB of flash) and draws displays of 800 x 480 and more
            with them, in a page area twice the 320 x 240 design size. The
            build turns it on for a board whose first display is that large
            (scripts/sdk_selection.py); a product may set it either way in
            its "options". Off: every display uses the 18 px set, and a large
            display shows its pages 1.75 times the design size.

endmenu
```

## sdk/themes/xiaotai_theme_lcd_kit/sdkconfig.defaults
```kconfig
CONFIG_LV_COLOR_DEPTH_16=y
CONFIG_LV_USE_CUSTOM_MALLOC=y
# CONFIG_LV_USE_SYSMON is not set
CONFIG_LV_FONT_FMT_TXT_LARGE=y
CONFIG_LV_USE_FONT_COMPRESSED=y
```

## sdk/xiaotai_at/Kconfig
```kconfig
# SPDX-License-Identifier: MIT
# Options of the XiaoTai console engine. Each maps to the macro of the same
# name without the CONFIG_ prefix in include/xiaotai/at_config.h; the
# defaults here and there are the same (test/at_config_test.c checks it).
# Products set the options per today's console (spec xiaotai_at.md 4.7).
menu "XiaoTai console engine"

    config XIAOTAI_AT_SOURCES_MAX
        int "Byte sources one console serves"
        range 1 8
        default 3
        help
            The platform console and every source a product attaches with
            xiaotai_at_attach(). Attaching one more is an error.

    config XIAOTAI_AT_LOCAL_MAX
        int "Local commands the table holds"
        range 12 128
        default 24
        help
            Commands that run on the console task, the engine's own nine
            included. Registering more is an error at init, so the start
            fails instead of losing a command. The table lives in external
            RAM where the board has it.

    config XIAOTAI_AT_VERB_SETS_MAX
        int "Verb tables the build registers"
        range 8 256
        default 48
        help
            One table per component and shared command (AT+CALL, AT+NET,
            AT+WAKE). Registering more is an error at init. The table lives
            in external RAM where the board has it.

    config XIAOTAI_AT_RESTART_COMMAND
        bool "Command AT+RESTART"
        default y
        help
            Orderly restart from the console (the framework quiesces the
            system and waits for the restart holds). Off for products whose
            console has no restart command today; the console then cannot
            restart the device.

    config XIAOTAI_AT_RESTART_FORCE
        bool "Command AT+RESTART FORCE"
        depends on XIAOTAI_AT_RESTART_COMMAND
        default y
        help
            Restart 200 ms after OK without asking any component. Off for
            products whose console restarts only when idle today.

    config XIAOTAI_AT_SETTING_WRITE
        bool "Command AT+SET <name> <value>"
        default y
        help
            Writing settings from the console. Reading them (AT+SET [<name>])
            stays either way. Off for products whose console changes no
            setting today.

    config XIAOTAI_AT_INTENT_COMMAND
        bool "Command AT+INTENT"
        default y
        help
            Posting intents from the console, as a button or the screen
            would. Intents registered as local only are refused either way.
            Off for products whose console has nothing it replaces today.

endmenu
```
