## sdk/xiaotai_framework/Kconfig
```kconfig
# SPDX-License-Identifier: MIT
# Options of the XiaoTai runtime framework. Each maps to the macro of the same
# name without the CONFIG_ prefix in include/xiaotai/framework_config.h; the
# defaults here and there are the same (the header holds the value without
# external RAM where the default depends on it).
menu "XiaoTai runtime framework"

    config XIAOTAI_FRAMEWORK_OWNER_ON_MAIN
        bool "Run the framework owner on the calling main task"
        default n
        help
            The successful xiaotai_start() call does not return. Use only
            with a console configuration that can run without the caller's
            separate service loop and a main task stack sized for the owner.

    config XIAOTAI_FRAMEWORK_OWNER_STACK_BYTES
        int "Stack of the owner task in bytes"
        range 4096 65536
        default 24576 if SPIRAM
        default 6144
        help
            Every handler of every engine, module and application runs on
            this task; each may use XIAOTAI_FRAMEWORK_HANDLER_STACK_BYTES
            (3072). Allocated as XIAOTAI_MEM_BULK. The "framework" diagnostic
            section reports it; measure the deepest path on the bench before
            lowering it.

    config XIAOTAI_FRAMEWORK_OWNER_PRIORITY
        int "Priority of the owner task"
        range 1 24
        default 5

    config XIAOTAI_FRAMEWORK_QUEUE_DEPTH
        int "Messages the owner task's queue holds"
        range 8 256
        default 32

    config XIAOTAI_FRAMEWORK_RESTART_DELAY_MS
        int "Delay between the restart announcement and the restart (ms)"
        range 0 10000
        default 1000

    config XIAOTAI_FRAMEWORK_RESTART_STACK_BYTES
        int "Stack of the task that performs the restart (bytes)"
        range 2048 16384
        default 4096
        help
            Internal RAM, only while the orderly restart calls
            xiaotai_restart(): on boards with a radio coprocessor the restart
            path must not run on a stack in external RAM.

    config XIAOTAI_FRAMEWORK_RESTART_GUARD_WAIT_MS
        int "Longest wait for the quiesce guards before a restart (ms)"
        range 0 60000
        default 10000

    config XIAOTAI_FRAMEWORK_MAX_MODULES
        int "Engines and modules"
        range 8 255
        default 48

    config XIAOTAI_FRAMEWORK_MAX_APPLICATIONS
        int "Applications"
        range 1 32
        default 8

    config XIAOTAI_FRAMEWORK_MAX_INTENTS
        int "Intents"
        range 16 1024
        default 96

    config XIAOTAI_FRAMEWORK_MAX_SUBSCRIBERS
        int "Event subscriptions"
        range 16 1024
        default 160

    config XIAOTAI_FRAMEWORK_COMPACT_SUBSCRIBERS
        bool "Use compiled event subscription descriptors"
        default n
        help
            Store only activation order and application scope for compiled
            descriptors. Runtime subscriptions allocate their data on demand.
            Only select this once the product's selected modules use const
            descriptors for enough registrations to achieve a net saving.

    config XIAOTAI_FRAMEWORK_MAX_ATTACHMENTS
        int "Activity attachments"
        range 1 64
        default 8

    config XIAOTAI_FRAMEWORK_MAX_SETTINGS
        int "Settings"
        range 8 512
        default 48

    config XIAOTAI_FRAMEWORK_MAX_COMMANDS
        int "Commands"
        range 8 512
        default 64

    config XIAOTAI_FRAMEWORK_MAX_DIAGNOSTICS
        int "Diagnostic sections"
        range 4 256
        default 32

    config XIAOTAI_FRAMEWORK_MAX_TIMERS
        int "Owner-task timers"
        range 4 256
        default 24
        help
            Timers pending at once. The preferences service keeps one slot
            permanently; with no free slot its writes are postponed, not lost.

    config XIAOTAI_FRAMEWORK_MAX_QUIESCE_GUARDS
        int "Quiesce guards"
        range 1 64
        default 8

endmenu
```

## sdk/xiaotai_interaction/Kconfig
```kconfig
# SPDX-License-Identifier: MIT
# Options of the XiaoTai interaction engine. Each maps to the macro of the
# same name without the CONFIG_ prefix in
# include/xiaotai/interaction_config.h; the defaults here and there are the
# same (the header holds the value without external RAM where the default
# depends on it).
menu "XiaoTai interaction engine"

    config XIAOTAI_INTERACTION_TASK
        bool "Own task for polling the inputs"
        default y if SPIRAM
        default n
        help
            With it, a task polls every input part each 10 ms. Without it, a
            timer on the framework owner task does the same: no task stack,
            but the polls run at the owner's priority and wait behind its
            handlers, so key timing is as late as the owner is busy.

    config XIAOTAI_INTERACTION_TASK_PRIORITY
        int "Priority of the input poll task"
        depends on XIAOTAI_INTERACTION_TASK
        range 1 24
        default 5
        help
            The task polls every input part each 10 ms. Keep it above the
            network tasks so a key is sampled on time during a TLS handshake.

    config XIAOTAI_INTERACTION_TASK_STACK_BYTES
        int "Stack of the input poll task in bytes"
        depends on XIAOTAI_INTERACTION_TASK
        range 1536 16384
        default 3072
        help
            Allocated as XIAOTAI_MEM_BULK (external RAM where the board has
            it); the task never touches flash or NVS.

    config XIAOTAI_INTERACTION_PROFILES_MAX
        int "Interaction profiles the registry holds"
        range 1 64
        default 8
        help
            Registering more is an error at init, so the start fails instead
            of losing a profile.

    config XIAOTAI_INTERACTION_LAYERS_MAX
        int "Layers pushed at once"
        range 1 16
        default 4

    config XIAOTAI_INTERACTION_INPUTS_MAX
        int "Input parts polled"
        range 1 32
        default 8

endmenu
```

## sdk/xiaotai_media/Kconfig
```kconfig
# SPDX-License-Identifier: MIT
# Options of the XiaoTai media engine. Each maps to the macro of the same name
# without the CONFIG_ prefix in include/xiaotai/media_config.h; the defaults
# here and there are the same.
menu "XiaoTai media engine"

    config XIAOTAI_MEDIA_ALAW_FIXED_FRAMES
        bool "Assemble selected A-law receive fragments into 20 ms frames"
        default n
        help
            Requires an explicit positive downlink.capacity_packets product
            parameter to bound complete frames and one partial frame together.

    config XIAOTAI_MEDIA_PROCESSOR_AEC_DUAL
        bool "Echo canceller for two microphones and a reference"
        default n
        help
            Builds the processor "aec.dual". It is used on boards whose audio
            input descriptor offers two microphone channels and a reference
            channel.

    config XIAOTAI_MEDIA_PROCESSOR_AEC_SINGLE_FRONTEND
        bool "Echo canceller for one microphone and a reference (speech front end)"
        default n
        help
            Builds the processor "aec.single.frontend": the canceller runs
            inside the speech front end, on the front end's own task.

    config XIAOTAI_MEDIA_PROCESSOR_AEC_SINGLE
        bool "Echo canceller for one microphone and a reference (direct)"
        default n
        help
            Builds the processor "aec.single": the canceller is called on the
            capture task, one frame per read.

    config XIAOTAI_MEDIA_AFE_MEMORY_EXTERNAL
        bool "Keep the speech front end's working set in external RAM"
        depends on SPIRAM
        default y
        help
            The processors "aec.dual" and "aec.single.frontend" ask the speech
            front end to place its working set (about 176 KB for two
            microphones) in external RAM. Without it the front end keeps that
            set in internal RAM. Turn it off only for a board whose measured
            front-end feed time does not fit its budget with external RAM.

    config XIAOTAI_MEDIA_EFFECT_AGC
        bool "Automatic gain control and uplink limiter"
        default n
        help
            Builds the effects "agc" (after echo control) and "boost" (on
            packets about to be encoded). Their amounts come from the media
            tuning table of the product configuration.

    config XIAOTAI_MEDIA_CODEC_OPUS_DECODER
        bool "Opus decoder"
        default n

    config XIAOTAI_MEDIA_CODEC_OPUS_ENCODER
        bool "Opus encoder"
        default n
        help
            Needs about 40 KiB of stack on the uplink task. Not needed for an
            audio input that already delivers Opus packets.

    config XIAOTAI_MEDIA_TRACE
        bool "Frame trace diagnostics"
        default n
        help
            Records a checksum per sent and received packet on request, for
            comparing what two devices exchanged. Up to 30000 frames per
            direction with external RAM (3000 when the command gives no
            count), up to 3000 without (750 by default). The buffer is
            allocated only when a trace is armed, so the option costs flash,
            not RAM.

    config XIAOTAI_MEDIA_TRACE_ARRIVALS
        bool "Record arrival metadata for opted-in sessions"
        depends on XIAOTAI_MEDIA_TRACE && SPIRAM
        default n
        help
            Retains the first 1024 arrival headers, not audio payloads, of
            an opted-in session. Uses one 16 KiB buffer in external RAM.
            Exposes the local read-only AT+AUDIOTRACE? query.

    config XIAOTAI_MEDIA_TEST_COMMANDS
        bool "Local audio test commands"
        default n
        help
            Registers AT+AUDIO TONE, RECORD, PLAY, STOP, DUMP and SENDTONE:
            a local test tone, one second of microphone recording, its
            playback and export over the console, and a test tone injected
            into the running session's uplink. RECORD and DUMP read the
            microphone through the console, so a product turns this on only
            where its current firmware already offers these commands. The
            recording buffer is allocated per command, so the option costs
            flash, not RAM. The bare AT+AUDIO query does not depend on it.

    config XIAOTAI_MEDIA_SOUND_COMMANDS
        bool "Sound preview commands"
        default n
        help
            Registers AT+SOUND (list), AT+SOUND PLAY and AT+SOUND STOP, which
            play any registered prompt, ring or guidance sound on request.
            A product turns this on only where its current firmware already
            offers sound previews on the console.

endmenu
```
